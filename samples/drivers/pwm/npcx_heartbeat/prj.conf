## CMakeLists.txt
```
# SPDX-License-Identifier: Apache-2.0

cmake_minimum_required(VERSION 3.20.0)
find_package(Zephyr REQUIRED HINTS $ENV{ZEPHYR_BASE})
project(samples_driver_pwm_npcx_heartbeat)

target_sources(app PRIVATE src/main.c)
```

## sample.yaml
```
sample:
  description: NPCX PWM heartbeat helper driver sample
  name: npcx pwm heartbeat
tests:
  sample.drivers.pwm.npcx_heartbeat:
    tags:
      - drivers
      - pwm
      - npcx
    depends_on: pwm
    filter: dt_compat_enabled("nuvoton,npcx-pwm-heartbeat")
    integration_platforms:
      - npcx4m8f_evb
    harness: console
    harness_config:
      type: multi_line
      ordered: true
      regex:
        - "NPCX PWM heartbeat sample start"
        - "STANDARD heartbeat profile applied, frequency: [0-9]+ Hz"
        - "VISUAL heartbeat profile applied, frequency: [0-9]+ Hz"
```

## prj.conf
```kconfig
CONFIG_PRINTK=y
CONFIG_PWM=y
CONFIG_PWM_NPCX_HEARTBEAT=y
```

## boards/npcx4m8f_evb.overlay
```dts
/*
 * Copyright (c) 2026 Nuvoton Technology Corporation
 *
 * SPDX-License-Identifier: Apache-2.0
 */

&pwm6 {
	status = "okay";
	pinctrl-0 = <&pwm6_gpc0>;
	pinctrl-names = "default";
};

/ {
	pwm_hb0: pwm_hb0 {
		compatible = "nuvoton,npcx-pwm-heartbeat";
		pwms = <&pwm6 0 20000000 0>;
		status = "okay";
	};
};
```

## src/main.c
```c
/*
 * Copyright (c) 2026 Nuvoton Technology Corporation
 *
 * SPDX-License-Identifier: Apache-2.0
 */

#include <zephyr/device.h>
#include <zephyr/drivers/pwm/pwm_hb_npcx.h>
#include <zephyr/kernel.h>
#include <zephyr/sys/printk.h>

#if !DT_HAS_COMPAT_STATUS_OKAY(nuvoton_npcx_pwm_heartbeat)
#error "No nuvoton,npcx-pwm-heartbeat node found in devicetree"
#endif

#define HB_NODE DT_COMPAT_GET_ANY_STATUS_OKAY(nuvoton_npcx_pwm_heartbeat)

static const struct pwm_npcx_hb_profile hb_profile1 = {
	.rise_time    = 1000u,     /* 1 second rise time  */
	.on_time      = 0,         /* no on time          */
	.fall_time    = 2000u,     /* 2 seconds fall time */
	.off_time     = 0,         /* no off time         */
	.hb_mode      = NPCX_PWM_HB_MODE_STANDARD,
	.max_duty_per = 100u,      /* 100% max duty cycle */
	.min_duty_per = 0u,        /* 0% min duty cycle   */
};

static const struct pwm_npcx_hb_profile hb_profile2 = {
	.rise_time    = 800u,     /* 0.8 second rise time */
	.on_time      = 400u,     /* 0.4 second on time   */
	.fall_time    = 800u,     /* 0.8 second fall time */
	.off_time     = 700u,     /* 0.7 second off time  */
	.hb_mode      = NPCX_PWM_HB_MODE_STANDARD,
	.max_duty_per = 80u,     /* 80% max duty cycle    */
	.min_duty_per = 5u,      /* 5% min duty cycle     */
};

int main(void)
{
	const struct device *const hb_dev = DEVICE_DT_GET(HB_NODE);
	uint16_t hz;

	if (!device_is_ready(hb_dev)) {
		printk("NPCX heartbeat device is not ready\n");
		return 0;
	}

	printk("NPCX PWM heartbeat sample start\n");

	while (1) {
		hz = pwm_npcx_hb_configure(hb_dev, &hb_profile1);
		if (hz == 0u) {
			printk("Failed to apply heartbeat profile\n");
			return 0;
		}
	
		k_sleep(K_SECONDS(9));
	
		hz = pwm_npcx_hb_configure(hb_dev, &hb_profile2);
		if (hz == 0u) {
			printk("Failed to apply heartbeat profile\n");
			return 0;
		}
	
		k_sleep(K_SECONDS(9));
	}

	return 0;
}
```
