## drivers/i2c/Kconfig.npcx
```kconfig
# NPCX I2C driver configuration options

# Copyright (c) 2020 Nuvoton Technology Corporation.
# SPDX-License-Identifier: Apache-2.0

menuconfig I2C_NPCX
	bool "Nuvoton NPCX embedded controller (EC) I2C driver"
	default y
	depends on DT_HAS_NUVOTON_NPCX_I2C_PORT_ENABLED
	help
	  This option enables the I2C driver for NPCX family of
	  processors.
	  Say y if you wish to use I2C modules on NPCX MCU.

config I2C_NPCX_PORT_INIT_PRIORITY
	int "NPCX I2C port init priority"
	default 51
	depends on I2C_NPCX
	help
	  Initialization priority for the I2C port on an NPCX device, must be
	  set to a lower priority than the controller one (I2C_INIT_PRIORITY).

config I2C_NPCX_CTRL
	bool "Nuvoton NPCX embedded controller (EC) I2C controller driver"
	default y
	depends on DT_HAS_NUVOTON_NPCX_I2C_PORT_ENABLED
	help
	  This option enables the I2C controller driver for NPCX family of
	  processors.
	  Say y if you wish to use I2C modules on NPCX MCU.

if I2C_NPCX_CTRL
config I2C_NPCX_DMA_DRIVEN
	bool "Nuvoton NPCX embedded controller (EC) I2C controller driver with DMA support"
	default y if SOC_SERIES_NPCK3
	help
	  This option enables the I2C controller driver which support DMA for NPCX family of
	  processors.
	  Say y if you wish to use I2C modules on NPCX MCU.
endif #I2C_NPCX_DMA_DRIVEN
```

## drivers/i3c/Kconfig.npcx
```kconfig
# NPCX I3C driver configuration options
# SPDX-License-Identifier: Apache-2.0

config I3C_NPCX
	bool "Nuvoton NPCX embedded controller (EC) I3C driver"
	depends on DT_HAS_NUVOTON_NPCX_I3C_ENABLED
	select RESET
	select I3C_IBI_WORKQUEUE if I3C_USE_IBI
	default y
	help
	  This option enables the I3C driver for NPCX family of
	  processors.
	  Say y if you wish to use I3C channels on NPCX MCU.
```

## drivers/led/Kconfig.xec
```kconfig
# Copyright (c) 2022 Microchip Technology Inc.
# SPDX-License-Identifier: Apache-2.0

config LED_XEC
	bool "Microchip XEC BB-LED driver"
	default y
        # Backport note: Drop this and use device tree when intercepting 3.2
	depends on LED
	help
	  Enable driver for the Microchip XEC Breathing-Blinking
	  LED controller
```

## dts/bindings/i3c/nuvoton,npcx-i3c.yaml
```yaml
# Copyright (c) 2024 Nuvoton Technology Corporation.
# SPDX-License-Identifier: Apache-2.0

description: |
    Nuvoton I3C controller

    Representation:

    /* If CONFIG_I3C_NPCX is enabled, the suggestion clock configuration as below */
    &pcc {
      clock-frequency = <DT_FREQ_M(90)>; /* OFMCLK runs at 90MHz */
      core-prescaler = <3>; /* CORE_CLK runs at 30MHz */
      apb1-prescaler = <6>; /* APB1_CLK runs at 15MHz */
      apb2-prescaler = <6>; /* APB2_CLK runs at 15MHz */
      apb3-prescaler = <6>; /* APB3_CLK runs at 15MHz */
      apb4-prescaler = <3>; /* APB4_CLK runs at 30MHz */
    };

    &i3c0 {
      status = "okay";
      pinctrl-0 = <&i3c1_sda_scl_gpe3_e4>;
      pinctrl-names = "default";

      i3c-scl-hz = <7500000>;
      i3c-od-scl-hz = <1500000>;
    };

compatible: "nuvoton,npcx-i3c"

include: [i3c-controller.yaml, pinctrl-device.yaml, reset-device.yaml]

properties:
  reg:
    required: true

  interrupts:
    required: true

  resets:
    required: true

  i3c-od-scl-hz:
    type: int
    description: |
      Open Drain Frequency for the I3C controller. When undefined, use
      the controller default or as specified by the I3C specification.

  clk-divider:
    type: int
    description: Main clock divider for I3C

  clk-divider-tc:
    type: int
    description: TC clock divider for I3C

  clk-divider-slow:
    type: int
    description: Slow clock divider for I3C

  disable-open-drain-high-pp:
    type: boolean
    description: |
      If false, open drain high time is 1 PPBAUD count,
      which is short high and long low.
      If true, open drain high time is same as ODBAUD
      so that open drain clock is 50% duty cycle.
      Default is false.

  instance-id:
    required: true
    type: int
    description: |
      Instance ID of the device, used to specify port number

  slave:
    required: false
    type: boolean
    description: Initialized as slave (default) / master

  secondary:
    required: false
    type: boolean
    description: Initialized as a secondary master

  static-address:
    required: false
    type: int
    description: |
      The default address of the device

  part-id:
    required: false
    type: int
    description: |
      PID[31:16], used for bus enumeration with entdaa

  vendor-id:
    required: false
    type: int
    description: |
      PID[11:0], used for bus enumeration with entdaa

  bcr:
    required: false
    type: int
    description: |
      Bus Characteristics Register, used for bus enumeration with entdaa

  dcr:
    required: false
    type: int
    description: |
      Device Characteristics Register, used for bus enumeration with entdaa

  mdma-channel:
    required: true
    type: int
    description: |
      mdma channel for I3C module transfer
```
