## drivers/espi/Kconfig.npcx
```kconfig
# NPCX eSPI driver configuration options

# Copyright (c) 2020 Nuvoton Technology Corporation.
# SPDX-License-Identifier: Apache-2.0

config ESPI_NPCX
	bool "Nuvoton NPCX embedded controller (EC) ESPI driver"
	default y
	depends on SOC_FAMILY_NPCX
	depends on DT_HAS_NUVOTON_NPCX_ESPI_ENABLED
	help
	  This option enables the Intel Enhanced Serial Peripheral Interface
	  (eSPI) for NPCX family of processors.

config ESPI_NPCX_HOST_SUB
	bool "Nuvoton NPCX embedded controller (EC) host sub modules driver"
	default y
	depends on ESPI_NPCX
	depends on DT_HAS_NUVOTON_NPCX_HOST_SUB_ENABLED
	help
	  This option enables NPCX Host Sub-Modules that serve as an interface
	  between the Host and Core domains.

config ESPI_NPCX_HOST_SUB_V2
	bool "Nuvoton NPCX embedded controller (EC) host sub modules driver"
	default n
	depends on ESPI_NPCX
	depends on DT_HAS_NUVOTON_NPCX_HOST_SUB_ENABLED
	help
	  This option enables NPCX Host Sub-Modules that serve as an interface
	  between the Host and Core domains.

config ESPI_NPCX_PERIPHERAL_ACPI_SHD_MEM_SIZE
	int "Host I/O peripheral port size for shared memory in npcx series"
	depends on ESPI_NPCX || ESPI_PERIPHERAL_ACPI_SHM_REGION
	default 256
	help
	  This is the port size used by the Host and EC to communicate over
	  the shared memory region to return the ACPI response data. Please
	  notice the valid value in npcx ec series for this option is 8/16/32/
	  64/128/256/512/1024/2048/4096 bytes.

config ESPI_NPCX_PERIPHERAL_HOST_CMD_PARAM_SIZE
	int "Host I/O peripheral port size for ec host command in npcx series"
	depends on ESPI_NPCX || ESPI_PERIPHERAL_EC_HOST_CMD
	default 256
	help
	  This is the port size used by the Host and EC to communicate over
	  the shared memory region to return the host command parameter data.
	  Please notice the valid value in npcx ec series for this option is
	  8/16/32/64/128/256/512/1024/2048/4096 bytes.

config ESPI_NPCX_BYPASS_CH_ENABLE_FATAL_ERROR
	bool
	depends on SOC_SERIES_NPCX7 || SOC_SERIES_NPCX9
	default y
	help
	  Workaround the issue documented in NPCX99nF errata rev1_2, No.3.10.
	  Enabling an eSPI channel during an eSPI transaction might
	  (with low probability) cause the eSPI_SIF module to transition to
	  a wrong state and therefore response with FATAL_ERROR on an incoming
	  transaction.

config ESPI_NPCX_PERIPHERAL_DEBUG_PORT_80_MULTI_BYTE
	bool "Host can write 1/2/4 bytes of Port80 data in a eSPI transaction"
	depends on (SOC_SERIES_NPCX9 || SOC_SERIES_NPCX4) && ESPI_PERIPHERAL_DEBUG_PORT_80
	select RING_BUFFER
	help
	  EC can accept 1/2/4 bytes of Port 80 data written from the Host in an
	  eSPI transaction.

config ESPI_NPCX_PERIPHERAL_DEBUG_PORT_80_RING_BUF_SIZE
	int "Debug Port80 ring buffer size"
	depends on ESPI_NPCX_PERIPHERAL_DEBUG_PORT_80_MULTI_BYTE
	default 256
	help
	  The size of the ring buffer in byte used by the Port80 ISR to store
	  Postcodes from Host.

config ESPI_TAF_NPCX
	bool "Nuvoton NPCX embedded controller (EC) ESPI TAF driver"
	depends on SOC_SERIES_NPCX4
	depends on FLASH
	help
	  This option enables the Intel Enhanced Serial Peripheral Interface
	  Target Attached Flash (eSPI TAF) for NPCX4 family of processors.

choice ESPI_TAF_ACCESS_MODE_CHOICE
	prompt "eSPI TAF Read Access Mode"
	default ESPI_TAF_AUTO_MODE

config ESPI_TAF_AUTO_MODE
	bool "eSPI TAF Automatic Mode"
	help
	  This is the setting to use auto mode for eSPI TAF read.

config ESPI_TAF_MANUAL_MODE
	bool "eSPI TAF Manual Mode"
	help
	  This is the setting to use manual mode for eSPI TAF read.

endchoice

config ESPI_TAF_PR_NUM
	int "Sets of protection region settings"
	default 16
	help
	  This size is display how many group of slave attached flash protection
	  region.

# The default value 'y' for the existing options if ESPI_NPCX is selected.
if ESPI_NPCX

config ESPI_OOB_CHANNEL
	default  y

config ESPI_PERIPHERAL_8042_KBC
	default y

config ESPI_PERIPHERAL_HOST_IO
	default y

config ESPI_PERIPHERAL_DEBUG_PORT_80
	default y

config ESPI_PERIPHERAL_EC_HOST_CMD
	default y

config ESPI_PERIPHERAL_ACPI_SHM_REGION
	default y

config ESPI_PERIPHERAL_CUSTOM_OPCODE
	default y

config ESPI_NPCX_SUPP_VW_GPIO
	bool "Indicates that the eSPI hardware supports virtual wire GPIOs"
	default y if SOC_SERIES_NPCX9 || SOC_SERIES_NPCX4
	help
	  Selected if NPCX series supports virtual wire GPIOs in eSPI module.

config ESPI_NPCX_CAF_GLOBAL_RESET_WORKAROUND
	bool
	default y if SOC_SERIES_NPCX4 && ESPI_FLASH_CHANNEL
	help
	  Workaround the issue "Global Reset" in the npcx4 SoC errata.

endif #ESPI_NPCX

if ESPI_NPCX_HOST_SUB_V2

config EC_HOST_CFG_BASE_ADDR
	hex "IO base address of EC Logical Device Configuration"
	default 0x4e
	help
	  This is the port number used by the Host and EC to communicate over
	  the eSPI peripheral channel for Logical Device Configuration.

config ESPI_PERIPHERAL_DEBUG_PORT_0_ADDR
	hex "Host I/O peripheral debug port 0 address for EC functionality"
	depends on ESPI_PERIPHERAL_DEBUG_PORT_80
	default 0x80
	help
	  This is the debug port 0 address used by the Host and EC to communicate over
	  the eSPI peripheral channel for EC functionality.

config ESPI_PERIPHERAL_DEBUG_PORT_0_SIZE
	int "Host I/O peripheral debug port 0 capture size"
	depends on ESPI_PERIPHERAL_DEBUG_PORT_80
	range 0 8
	default 1
	help
	  This is the number of consecutive I/O addresses captured from debug port 0
	  address within the same 8-byte aligned range. Use 0 to disable this debug
	  port address set.

config ESPI_PERIPHERAL_DEBUG_PORT_1_ADDR
	hex "Host I/O peripheral debug port 1 address for EC functionality"
	depends on ESPI_PERIPHERAL_DEBUG_PORT_80
	default 0x90
	help
	  This is the debug port 1 address used by the Host and EC to communicate over
	  the eSPI peripheral channel for EC functionality.

config ESPI_PERIPHERAL_DEBUG_PORT_1_SIZE
	int "Host I/O peripheral debug port 1 capture size"
	depends on ESPI_PERIPHERAL_DEBUG_PORT_80
	range 0 8
	default 1
	help
	  This is the number of consecutive I/O addresses captured from debug port 1
	  address within the same 8-byte aligned range. Use 0 to disable this debug
	  port address set.

config ESPI_PERIPHERAL_ACPI_PM1
	bool "Host I/O peripheral Private Channel"
	help
	  Enables ACPI Host I/O over eSPI peripheral channel for private channel.

config ESPI_PERIPHERAL_HOST_IO_PORT_NUM
	hex "Host I/O peripheral port number for ACPI  PM Channel 1"
	depends on ESPI_PERIPHERAL_HOST_IO
	default 0x62
	help
	  This is the port number used by the Host and EC to communicate over
	  the eSPI peripheral channel for ACPI  PM Channel 1.

config ESPI_PERIPHERAL_ACPI_PM2
	bool "Host I/O peripheral Private Channel"
	help
	  Enables ACPI Host I/O over eSPI peripheral channel for private channel.

config ESPI_PERIPHERAL_ACPI_PM2_PORT_NUM
	hex "Host I/O peripheral port number for ACPI  PM Channel 2"
	depends on ESPI_PERIPHERAL_ACPI_PM2
	default 0x68
	help
	  This is the port number used by the Host and EC to communicate over
	  the eSPI peripheral channel for ACPI  PM Channel 2.

config ESPI_PERIPHERAL_ACPI_PM3
	bool "Host I/O peripheral Private Channel"
	help
	  Enables ACPI Host I/O over eSPI peripheral channel for private channel.

config ESPI_PERIPHERAL_SHARED_WINDOW_CFG_PORT_NUM
	hex "Host I/O peripheral port number for EC Shared Memory configuration base adderss"
	default 0x0600
	help
	  This is the port number used by the Host and EC to configure EC shared memory windows.

config ESPI_PERIPHERAL_EXTENDED_SHARED_WINDOW_CFG_PORT_NUM
	hex "Host I/O peripheral port number for EC Extended Shared Memory configuration base adderss"
	default 0x0680
	help
	  This is the port number used by the Host and EC to configure EC shared memory windows.

config ESPI_PERIPHERAL_SHARED_WINDOW_1
	bool "EC modules driver for EC Shared Memory"
	depends on ESPI_NPCX
	default n
	help
	  Enables NPCX Embedded Controller (EC) host shared memory subsystem via eSPI
	  peripheral channel to support EC shared memory subsystem.

config ESPI_PERIPHERAL_SHARED_WINDOW_1_IO
	bool "EC modules driver for EC Shared Memory"
	depends on ESPI_PERIPHERAL_SHARED_WINDOW_1
	default n
	help
	  Enables NPCX Embedded Controller (EC) host shared memory subsystem via I/O transaction

config ESPI_PERIPHERAL_SHARED_WINDOW_1_PORT_NUM
	hex "Host I/O peripheral port number for EC Shared Memory"
	depends on ESPI_PERIPHERAL_SHARED_WINDOW_1
	default 0x1000
	help
	  This is the port number used by the Host and EC to communicate over
	  the eSPI peripheral channel for EC shared memory subsystem.

config ESPI_PERIPHERAL_SHARED_WINDOW_1_SIZE
	int "Host I/O peripheral address range for EC Shared Memory"
	depends on ESPI_PERIPHERAL_SHARED_WINDOW_1
	default 16
	help
	  The size of shared memory window 1.

config ESPI_PERIPHERAL_SHARED_WINDOW_2
	bool "EC modules driver for EC Shared Memory"
	depends on ESPI_NPCX
	default n
	help
	  Enables NPCX Embedded Controller (EC) host shared memory subsystem via eSPI
	  peripheral channel to support EC shared memory subsystem.

config ESPI_PERIPHERAL_SHARED_WINDOW_2_IO
	bool "EC modules driver for EC Shared Memory"
	depends on ESPI_PERIPHERAL_SHARED_WINDOW_2
	default n
	help
	  Enables NPCX Embedded Controller (EC) host shared memory subsystem via I/O transaction

config ESPI_PERIPHERAL_SHARED_WINDOW_2_PORT_NUM
	hex "Host I/O peripheral port number for EC Shared Memory"
	depends on ESPI_PERIPHERAL_SHARED_WINDOW_2
	default 0x2000
	help
	  This is the port number used by the Host and EC to communicate over
	  the eSPI peripheral channel for EC shared memory subsystem.

config ESPI_PERIPHERAL_SHARED_WINDOW_2_SIZE
	int "Host I/O peripheral address range for EC Shared Memory"
	depends on ESPI_PERIPHERAL_SHARED_WINDOW_2
	default 16
	help
	  The size of shared memory window 2.

config ESPI_PERIPHERAL_SHARED_WINDOW_3
	bool "EC modules driver for EC Shared Memory"
	depends on ESPI_NPCX
	default n
	help
	  Enables NPCX Embedded Controller (EC) host shared memory subsystem via eSPI
	  peripheral channel to support EC shared memory subsystem.

config ESPI_PERIPHERAL_SHARED_WINDOW_3_IO
	bool "EC modules driver for EC Shared Memory"
	depends on ESPI_PERIPHERAL_SHARED_WINDOW_3
	default n
	help
	  Enables NPCX Embedded Controller (EC) host shared memory subsystem via I/O transaction

config ESPI_PERIPHERAL_SHARED_WINDOW_3_PORT_NUM
	hex "Host I/O peripheral port number for EC Shared Memory"
	depends on ESPI_PERIPHERAL_SHARED_WINDOW_3
	default 0x3000
	help
	  This is the port number used by the Host and EC to communicate over
	  the eSPI peripheral channel for EC shared memory subsystem.

config ESPI_PERIPHERAL_SHARED_WINDOW_3_SIZE
	int "Host I/O peripheral address range for EC Shared Memory"
	depends on ESPI_PERIPHERAL_SHARED_WINDOW_3
	default 16
	help
	  The size of shared memory window 3.

config ESPI_PERIPHERAL_SHARED_WINDOW_4
	bool "EC modules driver for EC Shared Memory"
	depends on ESPI_NPCX
	default n
	help
	  Enables NPCX Embedded Controller (EC) host shared memory subsystem via eSPI
	  peripheral channel to support EC shared memory subsystem.

config ESPI_PERIPHERAL_SHARED_WINDOW_4_IO
	bool "EC modules driver for EC Shared Memory"
	depends on ESPI_PERIPHERAL_SHARED_WINDOW_4
	default n
	help
	  Enables NPCX Embedded Controller (EC) host shared memory subsystem via I/O transaction

config ESPI_PERIPHERAL_SHARED_WINDOW_4_PORT_NUM
	hex "Host I/O peripheral port number for EC Shared Memory"
	depends on ESPI_PERIPHERAL_SHARED_WINDOW_4
	default 0x4000
	help
	  This is the port number used by the Host and EC to communicate over
	  the eSPI peripheral channel for EC shared memory subsystem.

config ESPI_PERIPHERAL_SHARED_WINDOW_4_SIZE
	int "Host I/O peripheral address range for EC Shared Memory"
	depends on ESPI_PERIPHERAL_SHARED_WINDOW_4
	default 16
	help
	  The size of shared memory window 4.

config ESPI_PERIPHERAL_SHARED_MEMORY
	bool "EC modules driver for EC Shared Memory"
	depends on ESPI_PERIPHERAL_DEBUG_PORT_80 || \
	  ESPI_PERIPHERAL_SHARED_WINDOW_1 || \
	  ESPI_PERIPHERAL_SHARED_WINDOW_2 || \
	  ESPI_PERIPHERAL_SHARED_WINDOW_3 || \
	  ESPI_PERIPHERAL_SHARED_WINDOW_4
	default y
	help
	  Enables NPCX Embedded Controller (EC) shared memory subsystem while any of
	  debug port 80, shared memory channel 1-5 is selected

endif #ESPI_NPCX_HOST_SUB_V2
```

## drivers/misc/npcx_shm/Kconfig
```kconfig
# Copyright (c) 2026 Nuvoton Technology Corporation
# SPDX-License-Identifier: Apache-2.0

config NPCX_SHM
	bool "Nuvoton NPCX shared memory driver"
	default y if DT_HAS_NUVOTON_NPCX_SHM_WINDOW_ENABLED
	depends on SOC_FAMILY_NPCX
	help
	  Enable the Nuvoton NPCX shared memory (SHM) driver.
```

## drivers/pwm/Kconfig.npcx
```kconfig
# NPCX PWM driver configuration options

# Copyright (c) 2020 Nuvoton Technology Corporation.
# SPDX-License-Identifier: Apache-2.0

config PWM_NPCX
	bool "Nuvoton NPCX embedded controller (EC) PWM driver"
	default y
	depends on DT_HAS_NUVOTON_NPCX_PWM_ENABLED
	help
	  This option enables the PWM driver for NPCX family of
	  processors.
	  Say y if you wish to use pwm ports on NPCX MCU.

config PWM_NPCX_HEARTBEAT
	bool "Nuvoton NPCX PWM heartbeat helper/driver"
	depends on PWM_NPCX
	help
	  Enable NPCX heartbeat support.
	  This provides both:
	  - A helper API to configure heartbeat waveform registers.
	  - A devicetree-instantiated heartbeat profile device driver.
```

## dts/bindings/i2c/nuvoton,npcx-i2c-ctrl.yaml
```yaml
# Copyright (c) 2020 Nuvoton Technology Corporation.
# SPDX-License-Identifier: Apache-2.0

description: Nuvoton, NPCX-I2C controller node

compatible: "nuvoton,npcx-i2c-ctrl"

include: base.yaml

properties:
  reg:
    required: true
  clocks:
    required: true

  sbd-wui:
    type: phandle
    required: true
    description: |
      Mapping table between Wake-Up Input (WUI) and SMB_SBD signal.

      For example the WUI mapping on NPCX4 SMB0 would be
        sbd-wui = <&wui_smb0_2>;
```

## dts/bindings/misc/npcx_shm/nuvoton,npcx-shm-window.yaml
```yaml
# Copyright (c) 2026 Nuvoton Technology Corporation
# SPDX-License-Identifier: Apache-2.0

description: Nuvoton NPCX shared memory window instance

compatible: "nuvoton,npcx-shm-window"

include: base.yaml

properties:
  id:
    type: int
    required: true
    enum:
      - 1
      - 2
      - 3
      - 4
    description: Shared memory window index.
```

## dts/bindings/misc/npcx_shm/nuvoton,npcx-shm.yaml
```yaml
# Copyright (c) 2026 Nuvoton Technology Corporation
# SPDX-License-Identifier: Apache-2.0

description: Nuvoton NPCX shared memory controller

compatible: "nuvoton,npcx-shm"

include: base.yaml

properties:
  clocks:
    required: true
    description: PCC clock configuration for SHM controller

  reg:
    required: true
    description: SHM and C2H MMIO regions

  reg-names:
    required: true
    description: Name of each register space

  interrupts:
    required: true
    description: SHM interrupt line shared by all windows
```

## dts/bindings/pwm/nuvoton,npcx-pwm-heartbeat.yaml
```yaml
# Copyright (c) 2026 Nuvoton Technology Corporation
# SPDX-License-Identifier: Apache-2.0

description: Nuvoton NPCX PWM heartbeat profile device

compatible: "nuvoton,npcx-pwm-heartbeat"

include: base.yaml

properties:
  pwms:
    type: phandle-array
    required: true
    description: PWM controller used to generate heartbeat waveform.
```
